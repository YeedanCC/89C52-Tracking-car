#include <reg52.h>
#include "MoveState.h"
#include "Timer.h"
#include "Delay.h"

unsigned int s=0;
unsigned int f=0;
unsigned int k=0;

sbit D1=P3^3;
sbit D2=P3^4;
sbit D3=P3^5;
sbit D4=P3^6;
sbit D5=P3^7;

void Track()   //1为灭 0为亮   灭1   亮0     检测到黑线为灭1   
{
	
	if(D1==1&&D2==0&&D3==0&&D4==0&&D5==1) 							//小车在站点停靠，灯全灭都为1
		{
			
			PWML=0;                          //左电机初始转速
			PWMR=0;
				lcd1602_init();
	lcd1602_write_cmd(0x82); //确定显示位置 
	lcd1602_write_data(0x41);//确定显示内容 
	lcd1602_char(0,3,'Q');
                       //右电机初始转速
							lcd1602_init();
	lcd1602_write_cmd(0x82); //确定显示位置 
	lcd1602_write_data(0x41);//确定显示内容 
	lcd1602_char(0,5,s);		   
			s++;
			CarStop();
		}
////////////////////////////////////////////////////////////////////////////////////////////////////////////////////		
		
		
	if(D1==1&&D2==1&&D3==1&&D4==0&&D5==1)  //小车右边扫描到黑线（轻微偏右）  小车应该向右移动  0100
		{
			
			PWML=0;                           //左电机初始转速
			PWMR=70;     
							lcd1602_init();
	lcd1602_write_cmd(0x82); //确定显示位置 
	lcd1602_write_data(0x41);//确定显示内容 
	lcd1602_char(0,3,'R');
	                     //右电机初始转速
			   f++;
				lcd1602_write_cmd(0x82); //确定显示位置 
	lcd1602_write_data(0x41);//确定显示内容 
	lcd1602_char(0,8,f);
			CarGo();
		}
////////////////////////////////////////////////////////////////////////////////////////////////////////////////////		
		
//		if(D1==0&&D2==0&&D3==0&&D4==1)  //小车右边扫描到黑线（转小圈）  小车应该向右移动  1000
//		{
//			
//			PWML=15;                           //左电机初始转速
//			PWMR=40;                       //右电机初始转速
//			CarGo();
//			
//		}
////////////////////////////////////////////////////////////////////////////////////////////////////////////////////		
		
	if(D1==1&&D2==0&&D3==1&&D4==1&&D5==1)  //小车左边扫描到黑线（轻微偏右） 小车应该向左移动     0010
		{
			
			PWML=70;                           //左电机初始转速
			PWMR=0; 
							lcd1602_init();
	lcd1602_write_cmd(0x82); //确定显示位置 
	lcd1602_write_data(0x41);//确定显示内容 
	lcd1602_char(0,3,'L'); 
	k++;
		lcd1602_write_cmd(0x82); //确定显示位置 
	lcd1602_write_data(0x41);//确定显示内容 
	lcd1602_char(1,9,k);                     //右电机初始转速
			CarGo();
		}
////////////////////////////////////////////////////////////////////////////////////////////////////////////////////		
		
		
//		if(D1==0&&D2==0&&D3==1&&D4==1)  //小车左边扫描到黑线（转小圈）  小车应该向左移动  0001
//		{
//			
//			PWML=10;                           //左电机初始转速
//			PWMR=30;                       //右电机初始转速
//			CarGo();																									ll	
//			
//		}
////////////////////////////////////////////////////////////////////////////////////////////////////////////////////		
		
		
	if(D1==1&&D2==1&&D3==0&&D5==1&&D4==1)  //小车两边都接收到红外线  小车直行      全亮都为0
		{
			
			PWML=75;                           //左电机初始转速
			PWMR=75;
	lcd1602_init();
	lcd1602_write_cmd(0x82); //确定显示位置 
	lcd1602_write_data(0x41);//确定显示内容 
	lcd1602_char(0,3,'P');     
		lcd1602_init();
	lcd1602_write_cmd(0x82); //确定显示位置 
	lcd1602_write_data(0x41);//确定显示内容 
	lcd1602_char(1,1,'k');                 //右电机初始转速
			CarGo();
			
		}
}
